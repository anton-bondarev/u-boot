## drivers/ddr/rcm/1888tx018/Kconfig
```kconfig
config 1888TX018_DDR
	bool "1888tx018 DDR SDRAM driver"
	# ??? depends on TARGET_1888TX018
	depends on TARGET_1888TX018 || TARGET_1888BM18
	help
	  Enable DDR SDRAM controller for the 1888tx018 device.
```
