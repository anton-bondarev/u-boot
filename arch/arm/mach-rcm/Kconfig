## arch/arm/mach-rcm/Kconfig
```kconfig
if ARCH_RCM_ARM

choice
	prompt "RC-Module board select"

config TARGET_1879VM8YA
	bool "Support 1879VM8YA based boards"
	select SPL_DM_SERIAL
	select DM_SERIAL
	select SPL_DM_SPI
	select DM_SPI
	select SPI

endchoice

endif

source "board/rcm/mc127-05/Kconfig"
```

## arch/powerpc/cpu/ppc470s-bm18/Kconfig
```kconfig
menu "ppc470s-bm18 CPU"
	depends on PPC470S_BM18

config SYS_CPU
	default "ppc470s-bm18"

choice
	prompt "Target select"
	optional

config TARGET_1888BM18
	bool "Support 1888BM18"
	select SUPPORT_SPL
	select CREATE_ARCH_SYMLINK

endchoice

source "board/rcm/mb150-02/Kconfig"

endmenu
```

## arch/powerpc/cpu/ppc470s/Kconfig
```kconfig
menu "ppc470s CPU"
	depends on PPC470S

config SYS_CPU
	default "ppc470s"

choice
	prompt "Target select"
	optional

config TARGET_1888TX018
	bool "Support 1888TX018"
	select SUPPORT_SPL
	select CREATE_ARCH_SYMLINK

config TARGET_1888BM18
	bool "Support 1888BM18"
	select SUPPORT_SPL
	select CREATE_ARCH_SYMLINK

endchoice

source "board/rcm/mb115-01/Kconfig"
source "board/rcm/mb150-02/Kconfig"

endmenu
```

## board/rc-module/mpw7705/Kconfig
```kconfig
if TARGET_MPW7705

config SYS_BOARD
	default "mpw7705"

config SYS_VENDOR
	default "rc-module"

config SYS_CONFIG_NAME
	default "mpw7705"

config SYS_TEXT_BASE
	default 0x40100040

endif
```

## board/rcm/1888tx018/Kconfig
```kconfig
if TARGET_1888TX018

config SYS_BOARD
	default "1888tx018"

config SYS_VENDOR
	default "rcm"

config SYS_CONFIG_NAME
	default "1888tx018"

config SYS_TEXT_BASE
	default 0x4D000040

endif
```

## board/rcm/common/Kconfig
```kconfig
config FLASHWRITER
	bool "Flash devices programmer"
	help
		Need enable one or more parameters of u-boot configuration:
			CONFIG_SPL_SPI_FLASH_SUPPORT for SPI flash programming
			CONFIG_SPL_MMC_SUPPORT for MMC programming
			CONFIG_SPL_NOR_SUPPORT for NOR flash programming
			CONFIG_SPL_NAND_SUPPORT for NAND flash programming
	select SPL_MMC_WRITE
	select SPL_SYS_MALLOC_SIMPLE
	default n
```

## board/rcm/mc127-05/Kconfig
```kconfig
if TARGET_1879VM8YA

config SYS_BOARD
	default "mc127-05"

config SYS_VENDOR
	default "rcm"

config SYS_CONFIG_NAME
	default "1879vm8ya"

config SYS_TEXT_BASE
	default 0x0E100040


config ENV_OFFSET
	hex "Environment offset"
	help
		Offset from base address where is environment of u-boot"
	depends on ENV_IS_IN_SPI_FLASH || ENV_IS_IN_MMC
	default 0x140000 if ENV_IS_IN_SPI_FLASH || ENV_IS_IN_MMC

config ENV_SIZE
	hex "Environment size"
	help
		"Size of enviroment of u-boot"
	default 0x4000

config ENV_SECT_SIZE
	hex "Environment sector size"
	help
		"Size of sector of memory devices,where are storing data"
	depends on ENV_IS_IN_SPI_FLASH
	default 0x10000 if ENV_IS_IN_SPI_FLASH

endif
```

## board/rcm/mt150-02/Kconfig
```kconfig
if TARGET_1888BM18

config SYS_BOARD
	string "Name of board"
	default "mt150-02"

config SYS_VENDOR
	string "Vendor of board"
	default "rcm"

config SYS_CONFIG_NAME
	string "Name of configuration"
	default "1888bm18"

config SYS_TEXT_BASE
	hex "Entry point for u-boot startup"
	default 0x21E00040

config SPL_TEXT_BASE
	hex "Entry point for SPL startup"
	default 0x80020000

config SYS_SDRAM_BASE
	hex "Base address SDRAM memory"
	default 0x20000000

config ENV_SPI_MAX_HZ
	int "Spi bus maximal frequency"
	depends on ENV_IS_IN_SPI_FLASH
	help
		"Spi bus maximal frequency,can be lower"
	default 12500000

config ENV_ADDR
	hex "Environment absolute address"
	help
		"Address of environment for nor flash"
	depends on ENV_IS_IN_FLASH
	default 0x21040000

config ENV_OFFSET
	hex "Environment offset"
	help
		Offset from base address where is environment of u-boot"
	depends on ENV_IS_IN_NAND || ENV_IS_IN_FLASH || ENV_IS_IN_SPI_FLASH || ENV_IS_IN_MMC
	default 0x40000 if ENV_IS_IN_NAND
	default 0x1040000 if ENV_IS_IN_FLASH
	default 0x140000 if ENV_IS_IN_SPI_FLASH
	default 0xF0000 if ENV_IS_IN_MMC

config ENV_SIZE
	hex "Environment size"
	help
		"Size of enviroment of u-boot"
	default 0x4000

config ENV_SECT_SIZE
	hex "Environment sector size"
	help
		"Size of sector of memory devices,where are storing data"
	depends on ENV_IS_IN_NAND || ENV_IS_IN_FLASH || ENV_IS_IN_SPI_FLASH
	default 0x20000 if ENV_IS_IN_NAND
	default 0x40000 if ENV_IS_IN_FLASH
	default 0x10000 if ENV_IS_IN_SPI_FLASH

endif
```

## configs/mb115-01_defconfig
```kconfig
CONFIG_PPC=y
CONFIG_PPC32=y
CONFIG_PPC470S=y
CONFIG_PHYS_64BIT=y
CONFIG_TARGET_1888TX018=y
CONFIG_DEFAULT_DEVICE_TREE="mb115-01"
CONFIG_CLK=y
CONFIG_SPL_CLK=y
CONFIG_SPL_SERIAL_SUPPORT=y
CONFIG_SPL_LIBCOMMON_SUPPORT=y
CONFIG_SPL_LIBGENERIC_SUPPORT=y
CONFIG_SPL_SPI_FLASH_SUPPORT=y
CONFIG_SPL_BUILD=y
CONFIG_SPL_NAND_SUPPORT=y
CONFIG_SPL_NOR_SUPPORT=n
CONFIG_SPL_SPI_SUPPORT=y
CONFIG_SPL_LDSCRIPT="arch/powerpc/cpu/ppc470s/u-boot-spl.lds"
CONFIG_SPL_BOARD_INIT=y
CONFIG_SPL=y
CONFIG_SPI_FLASH=y
CONFIG_USB=y
CONFIG_DM_USB=y
CONFIG_USB_MUSB_GADGET=y
CONFIG_USB_MUSB_MODULE=y
CONFIG_USB_GADGET=y
CONFIG_USB_GADGET_MANUFACTURER="RC Module"
CONFIG_USB_MUSB_RCM=y
# Temporary VID - need to be changed
CONFIG_USB_GADGET_VENDOR_NUM=0x0005
# Temporary PID - need to be changed
CONFIG_USB_GADGET_PRODUCT_NUM=0x0002
CONFIG_USB_GADGET_DOWNLOAD=y
CONFIG_DEBUG_UART=y
CONFIG_DEBUG_UART_PL011=y
CONFIG_DEBUG_UART_BASE=0x3C05D000
CONFIG_DEBUG_UART_CLOCK=100000000
CONFIG_1888TX018_DDR=y
CONFIG_PL022_SPI=y
CONFIG_DM=y
CONFIG_SPL_DM=y
CONFIG_DM_WARN=y
CONFIG_BLK=y
CONFIG_SPL_BLK=y
CONFIG_SPI=y
CONFIG_DM_SPI=y
CONFIG_OF_LIBFDT=y
CONFIG_OF_SEPARATE=y
CONFIG_SPL_SEPARATE_BSS=y
CONFIG_SUPPORT_OF_CONTROL=y
CONFIG_OF_CONTROL=y
CONFIG_DTC=y
CONFIG_SPL_OF_CONTROL=y
CONFIG_DM_SEQ_ALIAS=y
CONFIG_SPL_DM_SEQ_ALIAS=y
CONFIG_DM_SPI_FLASH=y
CONFIG_SPI_FLASH_STMICRO=y
CONFIG_DM_GPIO=y
CONFIG_SPL_GPIO_SUPPORT=y
CONFIG_PL061_GPIO=y
CONFIG_SPL_LEGACY_IMAGE_SUPPORT=y
CONFIG_SPL_RAW_IMAGE_SUPPORT=n
CONFIG_PINCTRL=y
CONFIG_SPL_PINCTRL=y
CONFIG_PINCTRL_PL061=y
CONFIG_LOGLEVEL=8
CONFIG_SPL_LOGLEVEL=8
CONFIG_SYS_MALLOC_F_LEN=0x10000
CONFIG_DM_MMC=y
CONFIG_PCI=n
CONFIG_DM_SERIAL=y
CONFIG_SPL_DM_SERIAL=y
CONFIG_PL011_SERIAL=y
CONFIG_SPL_DM_MMC=y
CONFIG_MMC_RCM=y
CONFIG_SPL_MMC_SUPPORT=y
CONFIG_SYS_MMCSD_RAW_MODE_U_BOOT_USE_PARTITION=y
CONFIG_SYS_MMCSD_RAW_MODE_U_BOOT_USE_PARTITION_TYPE=y
CONFIG_SYS_MMCSD_RAW_MODE_U_BOOT_PARTITION_TYPE=0xdf
CONFIG_PARTITIONS=y
CONFIG_SPL_DOS_PARTITION=y
CONFIG_SPL_LIBDISK_SUPPORT=y
CONFIG_DM_ETH=y
CONFIG_NET=y
CONFIG_GRETH_ETH=y
CONFIG_NET_RANDOM_ETHADDR=y
CONFIG_CMD_DHCP=y
CONFIG_CMD_PING=y
CONFIG_CMD_GPIO=y
CONFIG_CMD_MMC=y
CONFIG_CMD_PART=y
CONFIG_CMD_FS_GENERIC=y
CONFIG_CMD_FAT=y
CONFIG_CMD_EXT4=y
CONFIG_CMD_MEMTEST=y
CONFIG_TX018_LSIF_CLOCK=y

CONFIG_CMD_MEMMAP=y

CONFIG_HUSH_PARSER=n
CONFIG_CMD_USB_MASS_STORAGE=y

CONFIG_ENV_IS_IN_SPI_FLASH=n
CONFIG_ENV_IS_IN_MMC=y
CONFIG_ENV_IS_IN_NAND=n
CONFIG_ENV_IS_IN_FLASH=n

CONFIG_USE_BOOTARGS=y
CONFIG_BOOTARGS="console=ttyAMA0 root=/dev/mmcblk0p2 rootwait"
CONFIG_USE_BOOTCOMMAND=y
CONFIG_BOOTCOMMAND="run kernelsd"

#### CONFIG_SPL_USE_TINY_PRINTF=n # for tiny %llu not working!!!if debug or something uses that format,must off tiny

CONFIG_BAUDRATE=1000000
CONFIG_SPL_I2C_SUPPORT=y
CONFIG_I2C_SUPPORT=y
CONFIG_DM_I2C=y
CONFIG_SYS_I2C_OCORES=y
CONFIG_MISC=y
CONFIG_SPL_DRIVERS_MISC_SUPPORT=y
CONFIG_SPL_I2C_EEPROM=y 
CONFIG_I2C_EEPROM=y 
CONFIG_ARCH_FIXUP_FDT_MEMORY=y
CONFIG_BLOCK_CACHE=y
# MTD NAND
CONFIG_MTD=y
CONFIG_MTD_UBI=y
CONFIG_CMD_MTDPARTS=y
CONFIG_NAND=y
CONFIG_CMD_NAND=y
CONFIG_CMD_UBIFS=y
CONFIG_MTD_RAW_NAND=y
CONFIG_DM_MTD=y
CONFIG_SYS_NAND_SELF_INIT=y
CONFIG_MTD_RCM_NAND=y
CONFIG_MTDPARTS=y
CONFIG_MTDIDS_DEFAULT="mtd0"
# MTD NOR
CONFIG_SPL_MTD_SUPPORT=y
CONFIG_SPL_REGMAP=y
CONFIG_REGMAP=y
CONFIG_PPC_DCR=y
CONFIG_MTD_NOR_FLASH=y
CONFIG_MTD_RCM_NOR=y
# LMB
CONFIG_NR_DRAM_BANKS=8
CONFIG_CMD_RCM_SRAM_NOR_TEST=y
```

## configs/mc127-05_defconfig
```kconfig
CONFIG_ARM=y
CONFIG_ARCH_RCM_ARM=y
CONFIG_TARGET_1879VM8YA=y
CONFIG_SPL_SERIAL_SUPPORT=y
CONFIG_SPL=y
CONFIG_SPL_SPI_SUPPORT=y
CONFIG_SPL_LIBCOMMON_SUPPORT=y
CONFIG_SPL_LIBGENERIC_SUPPORT=y
CONFIG_SPL_SPI_FLASH_SUPPORT=y
CONFIG_SPI_FLASH=y
CONFIG_SPI_FLASH_WINBOND=y
CONFIG_DEFAULT_DEVICE_TREE="mc127-05"
CONFIG_PSEUDO_SPI_SERIAL=y
CONFIG_PL022_SPI=y
CONFIG_SPL_LEGACY_IMAGE_SUPPORT=y
CONFIG_SPL_RAW_IMAGE_SUPPORT=n
CONFIG_DM_SPI_FLASH=y
CONFIG_SPL_RAM_DEVICE=y
CONFIG_SPL_RAM_SUPPORT=y
CONFIG_DM_ETH=y
CONFIG_NET=y
CONFIG_GRETH_ETH=y
CONFIG_NET_RANDOM_ETHADDR=y
CONFIG_CMD_DHCP=y
CONFIG_CMD_PING=y
CONFIG_ENV_IS_IN_SPI_FLASH=y
CONFIG_ENV_IS_IN_MMC=n
CONFIG_BLK=y
CONFIG_SPL_BLK=y
CONFIG_SPL_DM_MMC=y
CONFIG_DM_MMC=y
CONFIG_MMC_SPI=y
CONFIG_RCM_MMC_SPI=y
CONFIG_SPL_HASH_SUPPORT=y
CONFIG_CLK=y
CONFIG_SPL_CLK=y
CONFIG_MMC_IO_VOLTAGE=y
CONFIG_MMC_UHS_SUPPORT=y
CONFIG_SPL_MMC_SUPPORT=y
CONFIG_SYS_MMCSD_RAW_MODE_U_BOOT_USE_PARTITION=y
CONFIG_SYS_MMCSD_RAW_MODE_U_BOOT_USE_PARTITION_TYPE=y
CONFIG_SYS_MMCSD_RAW_MODE_U_BOOT_PARTITION_TYPE=0xdf
CONFIG_CMD_MMC=y
CONFIG_CMD_PART=y
CONFIG_CMD_FS_GENERIC=y
CONFIG_CMD_FAT=y
CONFIG_CMD_EXT4=y
CONFIG_PARTITIONS=y
CONFIG_SPL_DOS_PARTITION=y
CONFIG_SPL_LIBDISK_SUPPORT=y
CONFIG_SYS_MALLOC_F_LEN=0x8000
CONFIG_NETDEVICES=y
CONFIG_DM_GPIO=y
CONFIG_SPL_GPIO_SUPPORT=y
CONFIG_PL060_GPIO=y
CONFIG_NR_DRAM_BANKS=1

# CONFIG_CC_OPTIMIZE_FOR_SIZE=y
# CONFIG_MMC_TRACE=y
```

## configs/mpw7705_defconfig
```kconfig
CONFIG_PPC=y
CONFIG_PPC470S=y
CONFIG_TARGET_PPC470S=y
CONFIG_TARGET_MPW7705=y
CONFIG_DEFAULT_DEVICE_TREE="mpw7705"
CONFIG_SPL_SERIAL_SUPPORT=y
CONFIG_SPL_LIBCOMMON_SUPPORT=y
CONFIG_SPL_LIBGENERIC_SUPPORT=y
#CONFIG_SPL_MMC_SUPPORT=y
#CONFIG_SPL_LIBDISK_SUPPORT=y
CONFIG_SPL_SPI_FLASH_SUPPORT=y
CONFIG_SPL_SPI_SUPPORT=y
#CONFIG_SPL_FAT_SUPPORT=y
#CONFIG_SPL_EXT_SUPPORT=y
CONFIG_SPL_LDSCRIPT="arch/powerpc/cpu/ppc470s/u-boot-spl.lds"
CONFIG_BOOTDELAY=10
CONFIG_SPL=y
#CONFIG_MTD_NOR_FLASH=y
CONFIG_SPI_FLASH=y
CONFIG_USB=y
CONFIG_USB_STORAGE=y
CONFIG_DEBUG_UART=y
CONFIG_DEBUG_UART_PL011=y
CONFIG_DEBUG_UART_BASE=0x3C034000
CONFIG_DEBUG_UART_CLOCK=100000000
CONFIG_MPW7705_DDR=y
CONFIG_PL022_SPI=y
#CONFIG_FS_FAT=y
#CONFIG_FS_FAT_MAX_CLUSTSIZE=65536
CONFIG_DM=y
CONFIG_SPL_DM=y
CONFIG_DM_WARN=y
CONFIG_BLK=y
CONFIG_SPL_BLK=y
CONFIG_DM_SPI=y
CONFIG_OF_LIBFDT=y
CONFIG_OF_SEPARATE=y
CONFIG_SPL_SEPARATE_BSS=y
CONFIG_SUPPORT_OF_CONTROL=y
CONFIG_OF_CONTROL=y
CONFIG_DTC=y
CONFIG_SPL_OF_CONTROL=y
CONFIG_DM_SEQ_ALIAS=y
CONFIG_SPL_DM_SEQ_ALIAS=y
CONFIG_DM_SPI_FLASH=y
CONFIG_SPI_FLASH_STMICRO=y
CONFIG_DM_GPIO=y
CONFIG_SPL_GPIO_SUPPORT=y
CONFIG_PL061_GPIO=y

CONFIG_LED=y
CONFIG_DM_LED=y
CONFIG_SPL_LED=y
CONFIG_LED_GPIO=y
CONFIG_SPL_LED_GPIO=y
CONFIG_LED_BLINK=y
CONFIG_LED_STATUS=y
CONFIG_LED_STATUS_BLINKING=0
CONFIG_LED_STATUS_GPIO=y
CONFIG_LED_STATUS_BIT=1
CONFIG_LED_STATUS_STATE=2
CONFIG_LED_STATUS0=y

CONFIG_SPL_LEGACY_IMAGE_SUPPORT=y
CONFIG_SPL_RAW_IMAGE_SUPPORT=n

CONFIG_PINCTRL=y
CONFIG_SPL_PINCTRL=y
CONFIG_PINCTRL_PL061=y

CONFIG_LOGLEVEL=8
CONFIG_SPL_LOGLEVEL=8

CONFIG_SYS_MALLOC_F_LEN=0x2000

CONFIG_DM_MMC=y
CONFIG_PCI=n

CONFIG_DM_SERIAL=y
CONFIG_SPL_DM_SERIAL=y
CONFIG_PL011_SERIAL=y
```

## configs/mt143-05_defconfig
```kconfig
CONFIG_ARM=y
CONFIG_ARCH_RCM_ARM=y
CONFIG_TARGET_1888BC048=y
CONFIG_SPL_SERIAL_SUPPORT=y
CONFIG_RCM_MUART=y
CONFIG_BAUDRATE=6250000
CONFIG_DEBUG_UART=y
CONFIG_DEBUG_UART_BASE=0x01044000
CONFIG_DEBUG_UART_CLOCK=100000000
CONFIG_DEBUG_UART_RCM=y
CONFIG_CACHE=y
# CONFIG_L2X0_CACHE=y
CONFIG_SPL=y
CONFIG_SPL_SPI_SUPPORT=y
CONFIG_SPL_LIBCOMMON_SUPPORT=y
CONFIG_SPL_LDSCRIPT="board/rcm/mt143-05/u-boot-spl.lds"
CONFIG_SPL_LIBGENERIC_SUPPORT=y
CONFIG_SPL_SPI_FLASH_SUPPORT=y
CONFIG_SPI_FLASH=y
CONFIG_SPI_FLASH_WINBOND=y
CONFIG_DEFAULT_DEVICE_TREE="mt143-05"
CONFIG_PL022_SPI=y
CONFIG_SPL_LEGACY_IMAGE_SUPPORT=y
CONFIG_SPL_RAW_IMAGE_SUPPORT=n
CONFIG_DM_SPI_FLASH=y
CONFIG_SPL_RAM_DEVICE=y
CONFIG_SPL_RAM_SUPPORT=y
CONFIG_DM_ETH=y
CONFIG_NET=y
CONFIG_PINCTRL=y
CONFIG_PINCTRL_SINGLE=y
CONFIG_RCM_MGETH=y
CONFIG_PHY_TI=y
CONFIG_NET_RANDOM_ETHADDR=y
CONFIG_CMD_DHCP=y
CONFIG_CMD_PING=y
CONFIG_ENV_IS_IN_SPI_FLASH=n
CONFIG_ENV_IS_IN_MMC=n
CONFIG_BLK=y
CONFIG_SPL_BLK=y
CONFIG_SPL_DM_MMC=y
CONFIG_DM_MMC=y
CONFIG_MMC_RCM=y
CONFIG_SPL_HASH_SUPPORT=y
CONFIG_CLK=y
CONFIG_SPL_CLK=y
CONFIG_MMC_IO_VOLTAGE=y
CONFIG_MMC_UHS_SUPPORT=y
CONFIG_SPL_MMC_SUPPORT=y
CONFIG_SYS_MMCSD_RAW_MODE_U_BOOT_USE_PARTITION=y
CONFIG_SYS_MMCSD_RAW_MODE_U_BOOT_USE_PARTITION_TYPE=y
CONFIG_SYS_MMCSD_RAW_MODE_U_BOOT_PARTITION_TYPE=0xdf
CONFIG_CMD_MMC=y
CONFIG_CMD_PART=y
CONFIG_CMD_FS_GENERIC=y
CONFIG_CMD_FAT=y
CONFIG_CMD_EXT4=y
CONFIG_PARTITIONS=y
CONFIG_SPL_DOS_PARTITION=y
CONFIG_SPL_LIBDISK_SUPPORT=y
CONFIG_SYS_MALLOC_F_LEN=0x8000
CONFIG_NETDEVICES=y
CONFIG_DM_GPIO=y
CONFIG_SPL_GPIO_SUPPORT=y
CONFIG_RCM_GPIO=y
CONFIG_NR_DRAM_BANKS=1

# CONFIG_CC_OPTIMIZE_FOR_SIZE=y
# CONFIG_MMC_TRACE=y

CONFIG_ARCH_FIXUP_FDT_MEMORY=n
CONFIG_LOGLEVEL=8

CONFIG_ENV_IS_IN_EEPROM=y
CONFIG_SYS_I2C_RCM_BASIS=y
CONFIG_DM_I2C=y
CONFIG_CMD_I2C=y
CONFIG_MISC=y
CONFIG_CMD_EEPROM=y
CONFIG_I2C_EEPROM=y
CONFIG_SYS_I2C_EEPROM_ADDR=0x50
CONFIG_SYS_I2C_EEPROM_BUS=0
CONFIG_SYS_EEPROM_SIZE=8196
CONFIG_SYS_EEPROM_PAGE_WRITE_BITS=5
CONFIG_SYS_EEPROM_PAGE_WRITE_DELAY_MS=1
CONFIG_SYS_I2C_EEPROM_ADDR_LEN=2
CONFIG_SYS_I2C_EEPROM_ADDR_OVERFLOW=0x0
CONFIG_ENV_SIZE=0x1000
CONFIG_ENV_OFFSET=0x0
```

## configs/mt150-02_defconfig
```kconfig
CONFIG_PPC=y
CONFIG_PPC32=y
CONFIG_PPC470S=y
CONFIG_PHYS_64BIT=y
CONFIG_TARGET_1888BM18=y
CONFIG_DEFAULT_DEVICE_TREE="mt150-02"

CONFIG_LOGLEVEL=8
CONFIG_BAUDRATE=115200
CONFIG_DEBUG_UART=y
CONFIG_DEBUG_UART_PL011=y
CONFIG_DEBUG_UART_BASE=0xD0029000
CONFIG_DEBUG_UART_CLOCK=100000000
CONFIG_DEBUG_UART_SKIP_INIT=y # the UART speed is configured by RUMBOOT and it depens on the board switches

CONFIG_SPL=y
CONFIG_SPL_TEXT_BASE=0x80020000
CONFIG_SPL_SEPARATE_BSS=y
CONFIG_SPL_LDSCRIPT="arch/powerpc/cpu/ppc470s/u-boot-spl.lds"
CONFIG_SPL_BOARD_INIT=y
CONFIG_SPL_REGMAP=y
CONFIG_SPL_LIBCOMMON_SUPPORT=y
CONFIG_SPL_LIBGENERIC_SUPPORT=y
CONFIG_SPL_LEGACY_IMAGE_SUPPORT=y
CONFIG_SPL_LOGLEVEL=8

CONFIG_SPL_OF_CONTROL=y
CONFIG_SPL_DM=y
CONFIG_SPL_DM_SEQ_ALIAS=y
CONFIG_SPL_DM_SERIAL=y

CONFIG_SPL_DRIVERS_MISC_SUPPORT=y
CONFIG_SPL_MISC=y
CONFIG_SPL_SERIAL_SUPPORT=y
CONFIG_SPL_RCM_EMI_CORE=y

CONFIG_SYS_MALLOC_F_LEN=0x8000
CONFIG_REGMAP=y
CONFIG_PINCTRL=y
CONFIG_PINCTRL_PL061=y
CONFIG_CLK=y
CONFIG_OF_LIBFDT=y
CONFIG_OF_SEPARATE=y
CONFIG_SUPPORT_OF_CONTROL=y
CONFIG_OF_CONTROL=y
CONFIG_DTC=y
CONFIG_DM_SEQ_ALIAS=y
CONFIG_LZO=y
CONFIG_DM=y
CONFIG_DM_WARN=y
CONFIG_DM_SPI=y
CONFIG_DM_SPI_FLASH=y

CONFIG_SPI=y
CONFIG_SPI_FLASH=y
CONFIG_PL022_SPI=y
CONFIG_SPI_FLASH_STMICRO=y
CONFIG_SPI_FLASH_WINBOND=y
CONFIG_DM_GPIO=y
CONFIG_PL061_GPIO=y
CONFIG_DM_SERIAL=y
CONFIG_PL011_SERIAL=y
CONFIG_PL01X_SERIAL=y
CONFIG_DM_MMC=y
CONFIG_MMC_RCM=y
CONFIG_PARTITIONS=y
CONFIG_DM_ETH=y
CONFIG_NET=y
CONFIG_GRETH_ETH=y
CONFIG_NET_RANDOM_ETHADDR=y
CONFIG_DM_I2C=y
CONFIG_I2C_SUPPORT=y
CONFIG_SYS_I2C_OCORES=y
CONFIG_MISC=y
CONFIG_I2C_EEPROM=y
CONFIG_ARCH_FIXUP_FDT_MEMORY=y
CONFIG_BLOCK_CACHE=y
CONFIG_BLK=y
CONFIG_RCM_EMI_CORE=y

CONFIG_PCI=n # autoenabled if PPC
CONFIG_CMD_DHCP=y
CONFIG_CMD_PING=y
CONFIG_CMD_GPIO=y
CONFIG_CMD_MMC=y
CONFIG_CMD_PART=y
CONFIG_CMD_FS_GENERIC=y
CONFIG_CMD_FAT=y
CONFIG_CMD_EXT4=y
CONFIG_CMD_MEMTEST=y
CONFIG_CMD_MEMMAP=y

CONFIG_HUSH_PARSER=n

CONFIG_USE_BOOTARGS=y
CONFIG_BOOTARGS="console=ttyAMA0 root=/dev/mmcblk0p2 rootwait"
CONFIG_USE_BOOTCOMMAND=y
CONFIG_BOOTCOMMAND="run kernelsd"

CONFIG_ENV_IS_IN_SPI_FLASH=n
CONFIG_ENV_IS_IN_MMC=y
CONFIG_ENV_IS_IN_NAND=n
CONFIG_ENV_IS_IN_FLASH=n
CONFIG_BM018_CLK_IF=y
CONFIG_SPL_CLK=y
```

## drivers/clk/rcm/Kconfig
```kconfig
config TX018_LSIF_CLOCK
	bool "Enable TX018 LSIF clock driver"
	depends on CLK && TARGET_1888TX018
	help
	  Enable to configure lsif clock via Device Tree

config BM018_CLK_IF
	bool "Enable BM018 CLK IF driver"
	help
	  Enable to configure clk if via Device Tree
```

## drivers/ddr/rc-module/mpw7705/Kconfig
```kconfig
config MPW7705_DDR
	bool "mpw7705 DDR SDRAM driver"
	depends on TARGET_MPW7705
	help
	  Enable DDR SDRAM controller for the mpw7705 device.
```
