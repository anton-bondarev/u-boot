/*
 * Device Tree Source for RCM MT150.08 extention board (SDRAM)
 *
 * Copyright (C) 2020 MIR
 *	Mikhail.Petrov@mir.dev
 *
 * SPDX-License-Identifier: GPL-2.0+
 */
/ {
	plb {
		emi0: emi@80060000 {
			status = "okay";

			bank-1-ss = <(
					RCM_EMI_SSx_BTYP_SDRAM |
					RCM_EMI_SSx_PTYP_NO_PAGES |
					RCM_EMI_SSx_SRDY_EXT_RDY_NOT_USE |
					RCM_EMI_SSx_TWR_0 |
					RCM_EMI_SSx_SST_FLOW_THROUGH |
					RCM_EMI_SSx_TSSOE_1 |
					RCM_EMI_SSx_TSOE_1 |
					RCM_EMI_SSx_TCYC_8 |
					RCM_EMI_SSx_RDY(0) |
					RCM_EMI_SSx_TDEL_0)>;
			bank-1-sd = <(
					RCM_EMI_SDx_CSP_512 |
					RCM_EMI_SDx_SDS_8M |
					RCM_EMI_SDx_CL_3 |
					RCM_EMI_SDx_TRDL_2 |
					RCM_EMI_SDx_SI_CPU_INIT |
					RCM_EMI_SDx_T_RCD_3 |
					RCM_EMI_SDx_T_RAS_5)>;
			bank-1-ecc;
			bank-1-size = <0x2000000>; // 32MB
			emi-frc = <(RCM_EMI_RFC_TRFC_7 | RCM_EMI_RFC_RP(15603))>;
		};
	};
};
