/*
 * Device Tree Source for RCM MB115-02 board (Ethernet, NAND)
 *
 * This file is licensed under the terms of the GNU General Public
 * License version 2.  This program is licensed "as is" without
 * any warranty of any kind, whether express or implied.
 */

/ {
	sram_nor_arbiter0: sram_nor_arbiter {
		sram-nor-mux = <0>;      // 0 to route extmem wires to LSIF0, 1 - to MCIF
		ext-mem-mux-mode = <2>;  // page 913 0-SRAM_NOR(used for NOR)), 1-NAND, GBIT_GRETH0,GBIT_GRETH1, 2-GRETH0,GRETH1,NAND(used for NAND)
	};

	lsif0 {
		nand0: nand0@0x3C032000 {
			status = "okay";
			timings = <
				200  /* tADL_min (ONFI_2_0_Gold.pdf,page 47) */
				20   /* tALH_min                             */
				50   /* tALS_min                             */
				20   /* tCH_min                              */
				20   /* tCLH_min                             */
				50   /* tCLS_min                             */
				70   /* tCS_min                              */
				20   /* tDH_min                              */
				40   /* tDS_min                              */
				100  /* tWC_min                              */
				30   /* tWH_min                              */
				50   /* tWP_min                              */
				100  /* tWW_min                              */
				25   /* tAR_min                              */
				20   /* tCLR_min                             */
				0    /* tCOH_min                             */
				10   /* tIR_min                              */
				100  /* tRC_min                              */
				30   /* tREH_min                             */
				0    /* tRHOH_min                            */
				200  /* tRHW_min                             */
				0    /* tRLOH_min                            */
				50   /* tRP_min                              */
				40   /* tRR_min                              */
				120  /* tWHR_min                             */
				100  /* tCEA_max                             */
				100  /* tCHZ_max                             */
				40   /* tREA_max                             */
				200  /* tRHZ_max                             */
				200  /* tWB_max                              */
			>;
		};
	};
};
